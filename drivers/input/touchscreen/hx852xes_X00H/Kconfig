## drivers/input/touchscreen/hx852xes_X00H/Kconfig
```kconfig
#
# Himax Touchscreen driver configuration
#

config TOUCHSCREEN_HIMAX_I2C_X00H
        tristate "HIMAX HX852xES serious i2c touchscreen"
		depends on TOUCHSCREEN_HIMAX_HX852xES_X00H
		help
		This enables support for HIMAX HX852xES over I2C based touchscreens.

config TOUCHSCREEN_HIMAX_ITO_TEST_X00H
        tristate "HIMAX HX852xES ITO TEST"
		depends on TOUCHSCREEN_HIMAX_HX852xES_X00H
		help
		This enables support for HIMAX HX852xES ito test.

config TOUCHSCREEN_HIMAX_DEBUG_X00H
        tristate "HIMAX debug function"
		depends on TOUCHSCREEN_HIMAX_I2C_X00H
		help
		This enables support for HIMAX debug function.

config HMX_DB_X00H
	tristate "HIMAX driver test over Dragon Board"
	depends on TOUCHSCREEN_HIMAX_I2C_X00H
	help
	  This enables support for HIMAX driver test over Dragon Board.
```

## drivers/platform/asus/Kconfig
```kconfig
# Asus configuration options

config MACH_ASUS
	bool "Asus devices"
	help
	  Support for Asus variants

menu "Asus board selection"

config MACH_ASUS_X00H
        bool "X00H board"
        select MACH_ASUS
        help
          Support for Asus Zenfone 4 Max X00H MSM8917

config MACH_ASUS_X00I
        bool "X00I board"
        select MACH_ASUS
        help
          Support for Asus Zenfone 4 Max X00I MSM8937

config MACH_ASUS_X00P
        bool "X00P board"
        select MACH_ASUS
        help
          Support for Asus Zenfone Max M1 X00P MSM8917/MSM8937

config MACH_ASUS_X00R
        bool "X00R board"
        select MACH_ASUS
        help
          Support for Asus ZenFone Live L1 X00R MSM8917

endmenu
```
